/* board_nrf9160.c -- pdm_board.h for the Nordic nRF9160 DK + IIS3DWB.
 *
 * Target: nRF9160 SiP (Cortex-M33 @ 64 MHz, 1 MB flash, 256 kB RAM) with an
 *         integrated LTE-M/NB-IoT modem and GNSS. nRF Connect SDK (Zephyr).
 * Sensor: IIS3DWB on SPI3 (the DK's ADXL362 is retained for the wake-on-motion
 *         path only -- it cannot do condition monitoring, see the README).
 *
 * THIS CODE HAS NOT RUN ON HARDWARE.
 *
 * Two things make this driver different from the other MCU kits, and both come
 * from the 256 kB of RAM:
 *
 * 1. **There is no raw staging buffer.** The other kits read the sensor FIFO
 *    into an int16 block and convert it to float afterwards, which costs
 *    48 kB for an 8192-sample acquisition. Here each FIFO chunk is converted to
 *    float as it arrives, straight into the caller's buffer, using a 512-sample
 *    scratch that is reused. Saves 48 kB and costs nothing -- the conversion
 *    was going to happen anyway. Every kit should do this; this one had to.
 *
 * 2. **The window and twiddle tables are in flash** (PDM_TABLES_IN_FLASH),
 *    saving another 46 kB. Generated by cdsp/tools/gen_tables.py.
 *
 * Together those two take the pipeline from ~168 kB to ~101 kB, which is the
 * difference between leaving 20 kB for Zephyr plus the modem library and
 * leaving 90 kB.
 */

#include "pdm_board.h"

#include <string.h>

#include "app_config.h"
#include "pdm_pipeline.h"

#include <zephyr/devicetree.h>
#include <zephyr/drivers/adc.h>
#include <zephyr/drivers/gpio.h>
#include <zephyr/drivers/spi.h>
#include <zephyr/drivers/watchdog.h>
#include <zephyr/kernel.h>
#include <zephyr/logging/log.h>
#include <zephyr/sys/reboot.h>

#include <hal/nrf_ficr.h>
#include <modem/lte_lc.h>
#include <modem/modem_info.h>

LOG_MODULE_REGISTER(pdm_board, LOG_LEVEL_INF);

/* ---------------------------------------------------------------- devices */
#define ACCEL_NODE  DT_NODELABEL(iis3dwb)
static const struct spi_dt_spec s_accel = SPI_DT_SPEC_GET(
    ACCEL_NODE, SPI_WORD_SET(8) | SPI_TRANSFER_MSB | SPI_OP_MODE_MASTER, 0);
static const struct gpio_dt_spec s_led = GPIO_DT_SPEC_GET(DT_ALIAS(led0), gpios);
static const struct device *s_wdt;
static int s_wdt_channel = -1;

/* ADC for the battery divider. */
#define BATT_ADC_NODE DT_NODELABEL(adc)
static const struct device *s_adc;

/* ------------------------------------------------------------ IIS3DWB map */
#define IIS3DWB_WHO_AM_I          0x0Fu
#define IIS3DWB_WHO_AM_I_VALUE    0x7Bu
#define IIS3DWB_CTRL1_XL          0x10u
#define IIS3DWB_CTRL3_C           0x12u
#define IIS3DWB_CTRL5_C           0x14u
#define IIS3DWB_FIFO_CTRL3        0x09u
#define IIS3DWB_FIFO_CTRL4        0x0Au
#define IIS3DWB_FIFO_STATUS1      0x3Au
#define IIS3DWB_FIFO_DATA_OUT_X_L 0x3Eu
#define IIS3DWB_OUTX_L_XL         0x28u
#define IIS3DWB_CTRL1_26K7_16G    0x5Cu
#define IIS3DWB_CTRL3_BDU_IFINC   0x44u
#define IIS3DWB_FIFO_CONTINUOUS   0x06u

/* ------------------------------------------------------------------ state */
/* The only staging buffer: one FIFO-sized chunk, reused. 512 samples x 3 axes
 * x 2 bytes = 3 kB, against 48 kB for a full-block stage. */
#define CHUNK_SAMPLES 512u
static int16_t  s_chunk[CHUNK_SAMPLES * 3u];
static uint64_t s_uid;
static uint8_t  s_powered;
static int16_t  s_rssi = -99;
static float    s_shaft_hz;
static uint8_t  s_shaft_measured;

void pdm_board_nrf9160_set_shaft_hz(float hz, int measured)
{
    s_shaft_hz = hz;
    s_shaft_measured = measured ? 1u : 0u;
}

/* ---------------------------------------------------------------- SPI I/O */
static int reg_read(uint8_t reg, uint8_t *dst, size_t len)
{
    uint8_t cmd = (uint8_t)(reg | 0x80u);
    const struct spi_buf tx_buf = {.buf = &cmd, .len = 1u};
    const struct spi_buf_set tx = {.buffers = &tx_buf, .count = 1u};
    const struct spi_buf rx_bufs[2] = {
        {.buf = NULL, .len = 1u},      /* skip the command byte */
        {.buf = dst, .len = len},
    };
    const struct spi_buf_set rx = {.buffers = rx_bufs, .count = 2u};
    return spi_transceive_dt(&s_accel, &tx, &rx);
}

static int reg_write(uint8_t reg, uint8_t value)
{
    uint8_t buf[2] = {reg, value};
    const struct spi_buf tx_buf = {.buf = buf, .len = 2u};
    const struct spi_buf_set tx = {.buffers = &tx_buf, .count = 1u};
    return spi_write_dt(&s_accel, &tx);
}

/* --------------------------------------------------------------- selftest */
static pdm_board_status accel_selftest(void)
{
    int32_t base[3] = {0}, test[3] = {0};
    uint8_t raw[6];
    if (reg_write(IIS3DWB_CTRL1_XL, IIS3DWB_CTRL1_26K7_16G) != 0) {
        return PDM_BOARD_ERR_BUS;
    }
    k_msleep(100);
    for (int i = 0; i < 5; ++i) {
        k_msleep(2);
        if (reg_read(IIS3DWB_OUTX_L_XL, raw, 6u) != 0) {
            return PDM_BOARD_ERR_BUS;
        }
        for (int a = 0; a < 3; ++a) {
            base[a] += (int16_t)((uint16_t)raw[2 * a] | ((uint16_t)raw[2 * a + 1] << 8));
        }
    }
    (void)reg_write(IIS3DWB_CTRL5_C, 0x01u);
    k_msleep(100);
    for (int i = 0; i < 5; ++i) {
        k_msleep(2);
        if (reg_read(IIS3DWB_OUTX_L_XL, raw, 6u) != 0) {
            return PDM_BOARD_ERR_BUS;
        }
        for (int a = 0; a < 3; ++a) {
            test[a] += (int16_t)((uint16_t)raw[2 * a] | ((uint16_t)raw[2 * a + 1] << 8));
        }
    }
    (void)reg_write(IIS3DWB_CTRL5_C, 0x00u);
    for (int a = 0; a < 3; ++a) {
        const int32_t d = (test[a] - base[a]) / 5;
        const int32_t m = (d < 0) ? -d : d;
        if (m < 50 || m > 1700) {
            LOG_ERR("self-test axis %d delta %d outside [50, 1700]", a, m);
            return PDM_BOARD_ERR_SELFTEST;
        }
    }
    return PDM_BOARD_OK;
}

/* ------------------------------------------------------------------- init */
pdm_board_status pdm_board_init(pdm_board_info *info)
{
    /* FICR DEVICEID: 64 bits, globally unique per part. */
    s_uid = ((uint64_t)NRF_FICR->INFO.DEVICEID[1] << 32) | NRF_FICR->INFO.DEVICEID[0];

    if (info != NULL) {
        info->kit = APP_KIT_NAME;
        info->accel_part = "IIS3DWB";
        info->device_uid = s_uid;
        info->fs_hz = APP_FS_HZ;
        info->full_scale_g = APP_FULL_SCALE_G;
        info->adc_bits = 16u;
        info->flash_bytes = 1024u * 1024u;
        info->ram_bytes = 256u * 1024u;
    }

    if (!spi_is_ready_dt(&s_accel)) {
        LOG_ERR("SPI not ready");
        return PDM_BOARD_ERR_BUS;
    }
    (void)gpio_pin_configure_dt(&s_led, GPIO_OUTPUT_INACTIVE);

    s_adc = DEVICE_DT_GET(BATT_ADC_NODE);
    s_wdt = DEVICE_DT_GET(DT_NODELABEL(wdt0));
    if (device_is_ready(s_wdt)) {
        /* 120 s: long enough for an acquisition (0.4 s) plus the worst-case LTE
         * connection attempt. A watchdog shorter than the radio's worst case
         * reboots the node precisely when coverage is poor, which is when its
         * data matters most. */
        struct wdt_timeout_cfg cfg = {
            .window = {.min = 0u, .max = 120000u},
            .callback = NULL,
            .flags = WDT_FLAG_RESET_SOC,
        };
        s_wdt_channel = wdt_install_timeout(s_wdt, &cfg);
        (void)wdt_setup(s_wdt, WDT_OPT_PAUSE_HALTED_BY_DBG);
    }

    uint8_t who = 0;
    if (reg_read(IIS3DWB_WHO_AM_I, &who, 1u) != 0) {
        return PDM_BOARD_ERR_BUS;
    }
    if (who != IIS3DWB_WHO_AM_I_VALUE) {
        LOG_ERR("WHO_AM_I 0x%02x, expected 0x%02x", who, IIS3DWB_WHO_AM_I_VALUE);
        return PDM_BOARD_ERR_ID;
    }
    (void)reg_write(IIS3DWB_CTRL3_C, 0x01u);   /* reset */
    for (int i = 0; i < 20; ++i) {
        uint8_t c3 = 0xFFu;
        k_msleep(1);
        if (reg_read(IIS3DWB_CTRL3_C, &c3, 1u) == 0 && (c3 & 0x01u) == 0u) {
            break;
        }
    }
    (void)reg_write(IIS3DWB_CTRL3_C, IIS3DWB_CTRL3_BDU_IFINC);
    return accel_selftest();
}

pdm_board_status pdm_board_accel_power(int on)
{
    if (on) {
        if (reg_write(IIS3DWB_CTRL1_XL, IIS3DWB_CTRL1_26K7_16G) != 0) {
            return PDM_BOARD_ERR_BUS;
        }
        (void)reg_write(IIS3DWB_FIFO_CTRL3, 0x05u);
        (void)reg_write(IIS3DWB_FIFO_CTRL4, IIS3DWB_FIFO_CONTINUOUS);
    } else {
        (void)reg_write(IIS3DWB_FIFO_CTRL4, 0x00u);
        (void)reg_write(IIS3DWB_CTRL1_XL, 0x00u);
    }
    s_powered = on ? 1u : 0u;
    return PDM_BOARD_OK;
}

uint32_t pdm_board_accel_settle_ms(void)
{
    return APP_SENSOR_SETTLE_MS;
}

pdm_board_status pdm_board_acquire(float *out, size_t n, float *fs_hz_actual)
{
    if (out == NULL || n > APP_ACQ_SAMPLES) {
        return PDM_BOARD_ERR_NOT_READY;
    }
    if (!s_powered) {
        return PDM_BOARD_ERR_NOT_READY;
    }
    /* Flush, so the block starts now rather than containing the settling
     * transient we just waited out. */
    (void)reg_write(IIS3DWB_FIFO_CTRL4, 0x00u);
    (void)reg_write(IIS3DWB_FIFO_CTRL4, IIS3DWB_FIFO_CONTINUOUS);

    const float lsb_g = 2.0f * APP_FULL_SCALE_G / 65536.0f;
    const int64_t t_start = k_uptime_get();
    size_t done = 0;

    while (done < n) {
        size_t want = n - done;
        if (want > CHUNK_SAMPLES) {
            want = CHUNK_SAMPLES;
        }
        /* Wait for the chunk. The FIFO is 512 samples; at 26.667 kHz it fills in
         * 19.2 ms, and a 3 kB SPI burst at 8 MHz is 3 ms. The margin is only
         * real because nothing else runs: Zephyr's logging is deferred and the
         * modem is not transmitting (pdm_app.c serialises them). */
        uint32_t guard = 0;
        for (;;) {
            uint8_t st[2] = {0, 0};
            if (reg_read(IIS3DWB_FIFO_STATUS1, st, 2u) != 0) {
                return PDM_BOARD_ERR_BUS;
            }
            if ((st[1] & 0x40u) != 0u) {
                return PDM_BOARD_ERR_OVERRUN;
            }
            const uint16_t level = (uint16_t)(((uint16_t)(st[1] & 0x03u) << 8) | st[0]);
            if (level >= want) {
                break;
            }
            if (++guard > 200000u) {
                return PDM_BOARD_ERR_TIMEOUT;
            }
            k_yield();
        }
        if (reg_read(IIS3DWB_FIFO_DATA_OUT_X_L, (uint8_t *)s_chunk,
                     want * 3u * 2u) != 0) {
            return PDM_BOARD_ERR_BUS;
        }
        /* Convert straight into the caller's float buffer. This is the whole
         * trick: no 48 kB int16 staging block ever exists. */
        for (size_t i = 0; i < want; ++i) {
            out[done + i] = (float)s_chunk[i * 3u + 2u] * lsb_g;
        }
        done += want;
    }

    if (fs_hz_actual != NULL) {
        /* Measured, not nominal. k_uptime_get() runs from the 32.768 kHz LFCLK,
         * which on the nRF9160 DK is a +-20 ppm crystal. Over a 307 ms
         * acquisition the resolution is 1 ms, i.e. 0.33 % -- an order of
         * magnitude better than the IIS3DWB's +-3 % oscillator spec, and the
         * single cheapest accuracy improvement available on this kit.
         *
         * The STWIN.box cannot do this: nothing there times the acquisition
         * against a crystal. See docs/hardware/stwinbx1.md. */
        const int64_t elapsed_ms = k_uptime_get() - t_start;
        if (elapsed_ms > 50) {
            *fs_hz_actual = (float)n * 1000.0f / (float)elapsed_ms;
        } else {
            *fs_hz_actual = APP_FS_HZ;
        }
    }
    return PDM_BOARD_OK;
}

pdm_board_status pdm_board_shaft_hz(float *shaft_hz, int *estimated)
{
    if (shaft_hz == NULL || !(s_shaft_hz > 0.0f)) {
        return PDM_BOARD_ERR_NOT_READY;
    }
    *shaft_hz = s_shaft_hz;
    if (estimated != NULL) {
        *estimated = s_shaft_measured ? 0 : 1;
    }
    return PDM_BOARD_OK;
}

pdm_board_status pdm_board_temperature_c(float *temp_c)
{
    /* The IIS3DWB's own temperature sensor: +-3 degC, which is useless for
     * bearing temperature but fine as a context channel for the ambient
     * compensation the cloud applies to the health index. The DK has no better
     * sensor, and adding one is not worth a board revision. */
    uint8_t raw[2] = {0, 0};
    if (reg_read(0x20u, raw, 2u) != 0) {
        return PDM_BOARD_ERR_BUS;
    }
    const int16_t t = (int16_t)((uint16_t)raw[0] | ((uint16_t)raw[1] << 8));
    if (temp_c != NULL) {
        *temp_c = 25.0f + (float)t / 256.0f;
    }
    return PDM_BOARD_OK;
}

pdm_board_status pdm_board_battery_mv(uint16_t *mv)
{
    if (mv == NULL || !device_is_ready(s_adc)) {
        return PDM_BOARD_ERR_BUS;
    }
    int16_t sample = 0;
    struct adc_sequence seq = {
        .channels = BIT(0), .buffer = &sample, .buffer_size = sizeof(sample),
        .resolution = 12,
    };
    if (adc_read(s_adc, &seq) != 0) {
        return PDM_BOARD_ERR_BUS;
    }
    /* 0.6 V internal reference, 1/6 gain, 2:1 external divider. */
    *mv = (uint16_t)(((int32_t)sample * 600 * 6 * 2) / 4096);
    return PDM_BOARD_OK;
}

int16_t pdm_board_rssi_dbm(void)
{
    /* Modem RSRP, converted to a dBm-like figure. Worth reporting: on a
     * cellular node, a slowly degrading RSRP predicts the connection failures
     * that fill the queue, and distinguishes "the gateway is down" from "this
     * asset moved behind a new steel structure". */
    int rsrp = 0;
    if (modem_info_short_get(MODEM_INFO_RSRP, (uint16_t *)&rsrp) == 0) {
        s_rssi = (int16_t)(rsrp - 140);   /* 3GPP RSRP index to dBm */
    }
    return s_rssi;
}

/* ------------------------------------------------------------------ radio */
extern int lte_transport_publish_batch(const uint8_t *const *frames, const size_t *lens,
                                       size_t count);

pdm_board_status pdm_board_transmit(const uint8_t *frame, size_t len)
{
    const uint8_t *frames[1] = {frame};
    const size_t lens[1] = {len};
    return (lte_transport_publish_batch(frames, lens, 1u) == 0)
        ? PDM_BOARD_OK : PDM_BOARD_ERR_BUS;
}

/* ------------------------------------------------------------------ queue */
extern pdm_board_status nvs_queue_push(const uint8_t *frame, size_t len);
extern pdm_board_status nvs_queue_pop(uint8_t *frame, size_t cap, size_t *len);
extern uint32_t         nvs_queue_depth(void);

pdm_board_status pdm_board_queue_push(const uint8_t *frame, size_t len)
{
    return nvs_queue_push(frame, len);
}

pdm_board_status pdm_board_queue_pop(uint8_t *frame, size_t cap, size_t *len)
{
    return nvs_queue_pop(frame, cap, len);
}

uint32_t pdm_board_queue_depth(void)
{
    return nvs_queue_depth();
}

/* ------------------------------------------------------------------ sleep */
uint32_t pdm_board_sleep_ms(uint32_t ms)
{
    if (ms == 0u) {
        return 0u;
    }
    /* k_msleep with Zephyr's PM enabled puts the SoC into System ON idle with
     * the modem in PSM: roughly 3 uA, SRAM retained, and -- critically -- the
     * modem stays REGISTERED.
     *
     * System OFF would reach ~2 uA but drops the registration, so the next
     * transmission pays a full LTE attach (~1000 mA.s) instead of an RRC
     * connection (~95 mA.s). Saving 1 uA to spend 900 mA.s is a bad trade at
     * any interval under about a year.
     */
    k_msleep((int32_t)ms);
    return ms;
}

void pdm_board_identify(uint32_t seconds)
{
    for (uint32_t i = 0; i < seconds * 4u; ++i) {
        (void)gpio_pin_toggle_dt(&s_led);
        k_msleep(250);
    }
    (void)gpio_pin_set_dt(&s_led, 0);
}

void pdm_board_watchdog_feed(void)
{
    if (s_wdt_channel >= 0) {
        (void)wdt_feed(s_wdt, s_wdt_channel);
    }
}
